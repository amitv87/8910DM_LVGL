#include "liblwm2m.h"
#include "lwm2mclient.h"
#include "internals.h"
#include <stdio.h>
#include <stdlib.h>
#include <string.h>
#include <ctype.h>

lwm2m_object_t *get_skel_object(lwm2m_context_t *contextP, uint16_t objid, uint16_t instid, bool *isNewObj);

typedef lwm2m_object_t *(*obj_get_fuc)(void *lwm2mH);

typedef struct
{
    uint16_t objid;
    obj_get_fuc func;
} object_table_t;

object_table_t internal_obj_table[] = {
    {LWM2M_ACL_OBJECT_ID, acc_ctrl_create_object},
    {LWM2M_DEVICE_OBJECT_ID, get_object_device},
    {LWM2M_CONN_MONITOR_OBJECT_ID, get_object_conn_m},
    {LWM2M_FIRMWARE_UPDATE_OBJECT_ID, get_object_firmware},
    {LWM2M_LOCATION_OBJECT_ID, get_object_location},
    {LWM2M_CONN_STATS_OBJECT_ID, get_object_conn_s},
    //{TEST_OBJECT_ID ,get_test_object},
    //{LWM2M_TEMPERATURE_OBJECT_ID,get_temperature_object},
    //{LWM2M_ILLUMINANCE_OBJECT_ID,get_illuminance_object},
};

#define IPSO_STDOBJ_SIZE 1 //175
ipso_obj_t ipso_stdobj_table[] = {
#if 0
    { 10241,1,4,1,0, {{5905,1,1},{5906,1,1},{5907,1,1},{5908,1,1}}},
    { 10242,1,51,1,0, {{0,1,1},{1,1,1},{2,1,1},{3,1,1},{4,1,4},{5,1,4},{6,1,4},{7,1,4},{8,1,4},{9,1,4},{10,1,4},{11,1,4},{12,1,4},{13,1,4},{14,1,4},{15,1,4},{16,1,4},{17,1,4},{18,1,4},{19,1,4},{20,1,4},{21,1,4},{22,1,4},{23,1,4},{24,1,4},{25,1,4},{26,1,4},{27,1,4},{28,1,4},{29,1,4},{30,1,4},{31,1,4},{32,1,4},{33,1,4},{34,1,4},{35,1,4},{36,1,4},{37,1,4},{38,1,4},{39,1,4},{40,1,4},{41,1,4},{42,1,4},{43,1,4},{44,1,4},{45,1,4},{46,1,4},{47,1,4},{48,1,4},{49,1,4},{50,1,4}}},
    { 10243,1,18,1,0, {{0,1,1},{1,1,1},{2,1,1},{3,1,1},{4,1,1},{5,1,4},{6,1,4},{7,1,4},{8,1,4},{9,1,4},{10,1,4},{11,1,4},{12,1,4},{13,1,4},{14,1,4},{15,1,4},{16,1,4},{17,1,4}}},
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    { 18,0,13,1,0, {{0,0,3},{1,0,5},{2,0,3},{3,0,5},{4,0,5},{5,0,5},{6,0,5},{7,0,5},{8,0,5},{9,0,5},{10,0,3},{11,0,5},{12,0,5}}},
#endif
    {19, 1, 6, 1, 0, {{0, 0, 2}, {1, 0, 3}, {2, 0, 3}, {3, 0, 1}, {4, 0, 1}, {5, 0, 3}}},
    {0},
    {0},
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    {0},
};

static int find_internal_object(uint16_t objid)
{
    int size = sizeof(internal_obj_table) / sizeof(internal_obj_table[0]);
    for (int i = 0; i < size; i++)
        if (internal_obj_table[i].objid == objid)
            return i;
    return -1;
}

ipso_obj_t *lwm2m_get_ipso_obj(uint16_t objId, int16_t resId, ipso_res_t **ipso_res, uint8_t ref)
{
    int max_size = sizeof(ipso_stdobj_table) / sizeof(ipso_stdobj_table[0]);
    ipso_obj_t *type_array = ipso_stdobj_table;

    if (find_internal_object(objId) == -1 && lwm2m_is_dynamic_ipso(ref))
    {
        type_array = lwm2m_configs[ref]->obj_type_table;
        max_size = MAX_DYNAMIC_OBJECTS;
    }

    for (int i = 0; i < max_size; i++)
        if (type_array[i].objId == objId)
        {
            if ((int)resId != -1 && ipso_res != NULL)
            {
                for (int j = 0; j < type_array[i].resCount; j++)
                    if (type_array[i].resArray[j].resId == resId)
                    {
                        *ipso_res = &(type_array[i].resArray[j]);
                        break;
                    }
            }
            return &(type_array[i]);
        }
    return NULL;
}

lwm2m_tpye_t lwm2m_get_ipso_res_type(uint16_t objId, uint16_t resId)
{
    int size = sizeof(ipso_stdobj_table) / sizeof(ipso_stdobj_table[0]);
    ipso_obj_t *type_array = ipso_stdobj_table;

    for (int i = 0; i < size; i++)
    {
        if (type_array[i].objId == objId)
        {
            for (int j = 0; j < type_array[i].resCount; j++)
            {
                if (type_array[i].resArray[j].resId == resId)
                {
                    return type_array[i].resArray[j].value_type;
                }
            }
        }
    }
    return 0;
}

uint8_t lwm2m_isObjSupport(uint16_t objId, uint8_t ref)
{
    if (find_internal_object(objId) != -1)
        return true;

    int max_size = sizeof(ipso_stdobj_table) / sizeof(ipso_stdobj_table[0]);
    ipso_obj_t *type_array = ipso_stdobj_table;
    if (lwm2m_is_dynamic_ipso(ref))
    {
        type_array = lwm2m_configs[ref]->obj_type_table;
        max_size = MAX_DYNAMIC_OBJECTS;
    }

    for (int i = 0; i < max_size; i++)
        if (type_array[i].objId == objId)
            return true;
    return false;
}

bool lwm2m_isResReady(uint16_t objId, uint8_t ref)
{
    int max_size = sizeof(ipso_stdobj_table) / sizeof(ipso_stdobj_table[0]);
    ipso_obj_t *type_array = ipso_stdobj_table;
    if (lwm2m_is_dynamic_ipso(ref))
    {
        type_array = lwm2m_configs[ref]->obj_type_table;
        max_size = MAX_DYNAMIC_OBJECTS;
    }

    for (int i = 0; i < max_size; i++)
        if (type_array[i].objId == objId)
        {
            return type_array[i].isResReady;
        }
    return false;
}

bool lwm2m_isResDiscover(uint16_t objId, uint8_t ref)
{
    int max_size = sizeof(ipso_stdobj_table) / sizeof(ipso_stdobj_table[0]);
    ipso_obj_t *type_array = ipso_stdobj_table;
    if (lwm2m_is_dynamic_ipso(ref))
    {
        type_array = lwm2m_configs[ref]->obj_type_table;
        max_size = MAX_DYNAMIC_OBJECTS;
    }

    for (int i = 0; i < max_size; i++)
    {
        if (type_array[i].objId == objId)
        {
            return type_array[i].isDiscover;
        }
    }
    return false;
}

void lwm2m_resetResDiscoverState(uint16_t objId, uint8_t ref)
{
    int max_size = sizeof(ipso_stdobj_table) / sizeof(ipso_stdobj_table[0]);
    ipso_obj_t *type_array = ipso_stdobj_table;
    for (int i = 0; i < max_size; i++)
    {
        if (type_array[i].objId == objId)
        {
            type_array[i].isDiscover = false;
        }
    }
}

lwm2m_ret_t lwm2m_ipso_register(ipso_obj_t *ipso_obj, uint8_t ref)
{
    //if (!isRefValid(ref) || isRefRegistered(ref))
    //    return LWM2M_RET_ERROR;

    int max_size = sizeof(ipso_stdobj_table) / sizeof(ipso_stdobj_table[0]);
    ipso_obj_t *type_array = ipso_stdobj_table;
    int index = IPSO_STDOBJ_SIZE;
    if (lwm2m_is_dynamic_ipso(ref))
    {
        type_array = lwm2m_configs[ref]->obj_type_table;
        max_size = MAX_DYNAMIC_OBJECTS;
        index = 0;
    }

    int newIndex = -1;
    for (int i = index; i < max_size; i++)
    {
        if (type_array[i].objId == ipso_obj->objId)
        {
            newIndex = i;
            break;
        }
        else if (type_array[i].objId == 0 && newIndex == -1)
            newIndex = i;
    }
    if (newIndex != -1 && newIndex < MAX_INIT_OBJECTS)
    {
        type_array[newIndex].objId = ipso_obj->objId;
        memcpy(&type_array[newIndex], ipso_obj, sizeof(ipso_obj_t));
        return LWM2M_RET_OK;
    }

    return LWM2M_RET_ERROR;
}

void lwm2m_registNewObj(uint16_t objId, uint16_t resCount, uint8_t ref)
{
    int max_size = sizeof(ipso_stdobj_table) / sizeof(ipso_stdobj_table[0]);
    ipso_obj_t *type_array = ipso_stdobj_table;
    int index = IPSO_STDOBJ_SIZE;
    if (lwm2m_is_dynamic_ipso(ref))
    {
        type_array = lwm2m_configs[ref]->obj_type_table;
        max_size = MAX_DYNAMIC_OBJECTS;
        index = 0;
    }

    for (int i = index; i < max_size; i++)
        if (type_array[i].objId == 0)
        {
            type_array[i].objId = objId;
            type_array[i].resCount = resCount;
            break;
        }
}

int lwm2m_registNewRes(uint16_t objId, uint8_t *resString, uint8_t ref)
{
    int max_size = sizeof(ipso_stdobj_table) / sizeof(ipso_stdobj_table[0]);
    ipso_obj_t *type_array = ipso_stdobj_table;
    int index = 0;

    if (lwm2m_is_dynamic_ipso(ref))
    {
        type_array = lwm2m_configs[ref]->obj_type_table;
        max_size = MAX_DYNAMIC_OBJECTS;
    }

    for (int i = index; i < max_size; i++)
    {
        if (type_array[i].objId == objId)
        {
            bool isNewRes = false;
            if (!type_array[i].isResReady)
            {
                isNewRes = true;
            }

            int *value = lwm2m_malloc(type_array[i].resCount * 4);
            lwm2m_parse_buffer((char *)resString, value, type_array[i].resCount, ";");
            for (int j = 0; j < type_array[i].resCount; j++)
            {
                if ((const char *)value[j] == NULL)
                {
                    lwm2m_free(value);
                    return COAP_404_NOT_FOUND;
                }

                uint16_t resId = (uint16_t)atoi((const char *)value[j]);
                if (isNewRes)
                {
                    type_array[i].resArray[j].resId = resId;
                    if (!lwm2m_is_dynamic_ipso(ref))
                    {
                        type_array[i].resArray[j].value_type = lwm2m_get_ipso_res_type(objId, resId);
                    }
                }
                else
                {
                    bool isHasRes = false;
                    for (int temIndex = 0; temIndex < type_array[i].resCount; temIndex++)
                    {
                        if (type_array[i].resArray[temIndex].resId != resId)
                        {
                            continue;
                        }
                        else
                        {
                            isHasRes = true;
                            break;
                        }
                    }

                    if (!isHasRes)
                    {
                        lwm2m_free(value);
                        return -1;
                    }
                }
            }
            type_array[i].isResReady = true;
            type_array[i].isDiscover = true;
            lwm2m_free(value);
            return 1;
        }
    }
    return 0;
}

static lwm2m_object_t *get_internal_object(lwm2m_context_t *contextP, uint16_t objid, uint16_t instid, uint8_t *isNewObj)
{
    lwm2m_object_t *targetP;
    int index = find_internal_object(objid);
    if (index < 0)
        return NULL;

    targetP = (lwm2m_object_t *)LWM2M_LIST_FIND(contextP->objectList, objid);
    if (targetP == NULL)
    {
        targetP = internal_obj_table[index].func(contextP);
        if (targetP == NULL)
            return NULL;
        *isNewObj = true;
    }
    return targetP;
}

static lwm2m_object_t *add_object(lwm2m_context_t *contextP, uint16_t objid, uint16_t instid)
{
    lwm2m_object_t *targetP;
    bool isNewObj = false;

    LOG_ARG("add_object: /%d/%d", objid, instid);
    targetP = get_internal_object(contextP, objid, instid, (uint8_t *)&isNewObj);
    if (targetP == NULL)
        targetP = get_skel_object(contextP, objid, instid, &isNewObj);
    if (targetP == NULL)
        return NULL;

    if (isNewObj)
        contextP->objectList = (lwm2m_object_t *)LWM2M_LIST_ADD(contextP->objectList, targetP);
    lwm2m_list_t *inst = LWM2M_LIST_FIND(targetP->instanceList, instid);
    if (inst == NULL && targetP->createFunc != NULL)
        targetP->createFunc(instid, 0, NULL, targetP);
    else
    {
        if (isNewObj)
        {
            LWM2M_LIST_RM(contextP->objectList, objid, &targetP);
            lwm2m_free(targetP);
        }
        return NULL;
    }
    if (contextP->state == STATE_READY)
    {
        lwm2m_update_registration(contextP, 0, true);
    }

    return targetP;
}

bool add_mult_objinsts(lwm2m_context_t *contextP, uint16_t objid, uint32_t instCount, uint8_t *bitmap)
{
    //uint8_t result=0;
    uint32_t count = strlen((char *)bitmap);
    LOG_ARG("add_mult_objinsts bitmap:%s, instCount:%d", bitmap, instCount);
    if (count > instCount)
        count = instCount;
    for (int8_t i = count - 1; i >= 0; i--)
    {
        //LOG_ARG("bitmap[%d]:%c", i,bitmap[i]);
        if (bitmap[i] == '1')
        {
            if (add_object(contextP, objid, count - i - 1) == NULL)
            {
                LOG_ARG("add_mult_objinsts error ID: %d, instId:%d", objid, count - i - 1);
                return false;
            }
        }
    }
    return true;
}

void clean_all_objects(lwm2m_context_t *context)
{
    while (NULL != context->objectList)
    {
        lwm2m_object_t *object;
        object = context->objectList;
        context->objectList = object->next;
        object->cleanFunc(object);
    }
}
