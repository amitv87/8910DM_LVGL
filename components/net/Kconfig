## components/net/Kconfig
```kconfig
# Copyright (C) 2018 RDA Technologies Limited and/or its affiliates("RDA").
# All rights reserved.
#
# This software is supplied "AS IS" without any warranties.
# RDA assumes no responsibility or liability for the use of the software,
# conveys no license or title under any patent, copyright, or mask work
# right to the product. RDA reserves the right to make changes in the
# software without notification.  RDA also make no representation or
# warranty that such application will be suitable for the specified use
# without further testing or modification.

menu "net"

config NET_LWIP_DEBUG
    bool "enable lwip debug"
    default y
    help
        when enabled, LWIP_DEBUG will be defined to 1.

config NET_TCPIP_SUPPORT
    bool "tcpip enabled"
    default y
    help
        When enabled, CONFIG_NET_TCPIP_SUPPORT will be defined

config NET_LOG_BUF_COUNT
    int "Log buffer count"
    default 2

config NET_LOG_BUF_SIZE
    int "Log buffer size"
    default 8192

config NET_LWIP_IPV4_ON
    bool "Ipv4 enabled"
    default y
    help
        When enabled, CONFIG_NET_LWIP_IPV4_ON will be defined

config NET_LWIP_PPP_ON
    bool "ppp enabled"
    default y
    help
        When enabled, CONFIG_NET_LWIP_PPP_ON will be defined

config NET_TRACE_IP_PACKET
    bool "trace IP packet identify"
    default y if SOC_8910
    default n
    help
        When enabled, identify of IP packet will be show in trace.

        It is just for debug, and usually not needed in produciton.

config NET_LWM2M_SUPPORT
    bool "NET_LWM2M_SUPPORT enabled"
    default y
    help
        When enabled, NET_LWM2M_SUPPORT will be defined

config NET_PAHO_MQTT_SUPPORT
    bool "NET_PAHO_MQTT_SUPPORT enabled"
    default n
    help
        When enabled, NET_PAHO_MQTT_SUPPORT will be defined

config NET_ALI_SDK_SUPPORT
    bool "NET_ALI_SDK_SUPPORT enabled"
    default y
    help
        When enabled, NET_ALI_SDK_SUPPORT will be defined

config NET_ALI_SDK_DYNAMIC_LOAD
    bool "NET_ALI_SDK_DYNAMIC_LOAD enabled"
    default n
    help
        When enabled, NET_ALI_SDK_DYNAMIC_LOAD will be defined

config NET_CIS_SDK_SUPPORT
    bool "NET_CIS_SDK_SUPPORT enabled"
    default n
    help
        When enabled, NET_CIS_SDK_SUPPORT will be defined

config NET_NAT_SUPPORT
    bool "NET_NAT_SUPPORT enabled"
    default y
    help
        When enabled, NET_NAT_SUPPORT will be defined
orsource "mupnp/Kconfig"
orsource "http/Kconfig"
orsource "mbedtls/Kconfig"
orsource "liblwm2m/Kconfig"
orsource "ftp/Kconfig"

endmenu
```

## components/net/mbedtls/Kconfig
```kconfig
# Copyright (C) 2018 RDA Technologies Limited and/or its affiliates("RDA").
# All rights reserved.
#
# This software is supplied "AS IS" without any warranties.
# RDA assumes no responsibility or liability for the use of the software,
# conveys no license or title under any patent, copyright, or mask work
# right to the product. RDA reserves the right to make changes in the
# software without notification.  RDA also make no representation or
# warranty that such application will be suitable for the specified use
# without further testing or modification.

menu "mbedtls"

config MBEDTLS_REDUCE_MEMORY
    bool "MBEDTLS_REDUCE_MEMORY enabled"
    default n
    help
        When enabled, MBEDTLS_REDUCE_MEMORY will be defined
config MBEDTLS_LITE_CRYPTS
    bool "MBEDTLS_LITE_CRYPTS enabled"
    default n
    help
        When enabled, MBEDTLS_LITE_CRYPTS will be defined
endmenu
```

## components/ql-kernel/Kconfig
```kconfig
# Copyright (C) 2020 Quectel.
# All rights reserved.
#

menu "quectel core customize"

config QL_PROJECT_DEF
    string "Specify Project for Quectel"
    default ""
	
config QL_PROJECT_DEF_SUB
    string "Specify Sub Project for Quectel"
    default ""

endmenu
```

## components/rpc/Kconfig
```kconfig
# Copyright (C) 2018 RDA Technologies Limited and/or its affiliates("RDA").
# All rights reserved.
#
# This software is supplied "AS IS" without any warranties.
# RDA assumes no responsibility or liability for the use of the software,
# conveys no license or title under any patent, copyright, or mask work
# right to the product. RDA reserves the right to make changes in the
# software without notification.  RDA also make no representation or
# warranty that such application will be suitable for the specified use
# without further testing or modification.

menu "AP/CP RPC"

config RPC_SEND_STACK_ALLOCA_LIMIT
    int "Size limit to use stack (alloca) on send"
    default 256
    help
        RPC send can be called in multiple threads. When one thread
        is wating response from peer, it is permitted to let another
        thread to send call packet to peer when one thread. In normal
        case, there are no differences due to there is only one
        thread in peer, and all requests are handled one by one.
        However, when peer is busy, it is possible there may exist
        differences, and async message can be faster. So, we can't
        use global memory for input and output parameters.

        When input and output parameter memory size is small, alloca
        will be used, and malloc/free can be saved. When memory size
        is large, malloc/free shall be used to avoid stack overflow.
        Anyway, malloc/free can be non-trivial operation.

config RPC_PACKET_SIZE_MAX
    int "RPC packet max size"
    default 1024
    help
        The maximum of RPC packet size, including RPC call packet, RPC
        response packet and RPC async message packet.

config RPC_EVENT_RANGE_COUNT
    int "RPC event range count"
    default 4
    help
        When RPC daemon received an event from peer, RPC daemon itself
        donesn't know how to do with the event. Application shoule
        register router for specified events, usually send the event
        to desired thread.

        It is tedious to use dynamic memory for the registration. So,
        static memory is used, and this configures the maximum count.

endmenu
```

## components/service/Kconfig
```kconfig
# Copyright (C) 2018 RDA Technologies Limited and/or its affiliates("RDA").
# All rights reserved.
#
# This software is supplied "AS IS" without any warranties.
# RDA assumes no responsibility or liability for the use of the software,
# conveys no license or title under any patent, copyright, or mask work
# right to the product. RDA reserves the right to make changes in the
# software without notification.  RDA also make no representation or
# warranty that such application will be suitable for the specified use
# without further testing or modification.

menu "Services"

config USB_TRACE_ENABLE
    bool "Enable trace through USB"
    default y if SOC_8910
    default n
    help
        When enabled, trace device can be selected to USB serial. Also,
        USB serial can accept host commands from PC.

config FS_TRACE_ENABLE
    bool "Enable write trace to file system"
    depends on FS_MOUNT_SDCARD
    default y
    help
        When enabled, various trace data can be written to file system.
        Typically, they should be written to SDCARD.

config TWOLINE_WAKEUP_ENABLE
    bool "Enable two line wakeup mechanism"
    default n
    help
        Enable the funtion, you should call the srv2LineWakeUpInit and give the gpio id of
        wakeup_in and wakeup_out to the init function.

if TWOLINE_WAKEUP_ENABLE
config TWOLINE_WAKEUP_IN_GPIO
    int "The gpio id of wakeup_in"
    default 17
    help
        Be used for 2line wake up mechanism, notify module wakeup.

config TWOLINE_WAKEUP_OUT_GPIO
    int "The gpio id of wakeup_out"
    default 18
    help
        Be used for 2line wake up mechanism, notify mcu wakeup.
endif

config SRV_DTR_ENABLE
    bool "Enable DTR"
    default n
    help
        When enabled, one GPIO will be used to simulate DTR.

if SRV_DTR_ENABLE
config SRV_DTR_GPIO
    int "DTR GPIO"
    default 13 if SOC_8910
    help
        The GPIO to be used to simulate DTR.

config SRV_DTR_DEBOUNCE_ENABLE
    bool "Enable DTR GPIO software debounce"
    default y
    help
        When enabled, there is software debounce for the DTR GPIO.

if SRV_DTR_DEBOUNCE_ENABLE
config SRV_DTR_DEBOUNCE_TIME
    int "DTR GPIO software debounce time (ms)"
    default 20
    help
        The software debounce time of DTR GPIO.
endif
endif

config SRV_SIMLOCK_ENABLE
    bool "Enable simlock service"
    default y
    help
        Enbale simlock service.

config SRV_POWER_ON_VOLTAGE
    int "Power on voltage"
    default 3400

config SRV_POWER_OFF_VOLTAGE
    int "Power off voltage"
    default 3250

endmenu
```

## components/tts/Kconfig
```kconfig
# Copyright (C) 2018 RDA Technologies Limited and/or its affiliates("RDA").
# All rights reserved.
#
# This software is supplied "AS IS" without any warranties.
# RDA assumes no responsibility or liability for the use of the software,
# conveys no license or title under any patent, copyright, or mask work
# right to the product. RDA reserves the right to make changes in the
# software without notification.  RDA also make no representation or
# warranty that such application will be suitable for the specified use
# without further testing or modification.

menu "TTS"

config TTS_SUPPORT
    bool "TTS supported"
    default y if SOC_8910
    default n
    help
        When enabled, at least one TTS engine should be supported.

if TTS_SUPPORT
config TTS_STACK_SIZE
    int "TTS thread stack size"
    default 8192
    help
        TTS engine will run in separated thread. The stack size in bytes
        shall be determined by the used TTS engine.

config TTS_PCM_SAMPLE_RATE
    int "TTS synthesis PCM sample rate"
    default 16000
    help
        TTS engine output PCM sample rate. And the format is fixed to
        signed 16bits, mono.

config TTS_DUMMY_SUPPORT
    bool "Enable dummy TTS engine"
    default y
    help
        Dummy TTS engine is not a real TTS engine. It will synthesis text
        into some tones. It is just to demonstrate how to integrate TTS
        engine.

        When real TTS engine is used, it must be disabled.
endif

endmenu
```
