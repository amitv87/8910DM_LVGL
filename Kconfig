## components/diag/Kconfig
```kconfig
# Copyright (C) 2018 RDA Technologies Limited and/or its affiliates("RDA").
# All rights reserved.
#
# This software is supplied "AS IS" without any warranties.
# RDA assumes no responsibility or liability for the use of the software,
# conveys no license or title under any patent, copyright, or mask work
# right to the product. RDA reserves the right to make changes in the
# software without notification.  RDA also make no representation or
# warranty that such application will be suitable for the specified use
# without further testing or modification.

menu "Diag"

config DIAG_ENABLED
    bool "Enable diag"
    default y if SOC_8910
    default n

if DIAG_ENABLED
config DIAG_NORMAL_MODE_BUF_SIZE
    hex "Diag pre-allocated buffer size"
    default 0x1040 if SOC_8811
    default 0x10040
    help
        Pre-allocated buffer. When diag engine is created, buffer of this
        size will be allocated. When it is enough for diag packet, this
        pre-allocated buffer will be used. Otherwise, dynamic memory will
        be used. When dynamic memory allocation fails, diag will return
        bad command.

        When system memory is enough, it is recommended to configure the
        size to ensure maximum nvitem read and write can work.

config DIAG_CALIB_MODE_BUF_SIZE
    hex "Diag allocated buffer size in calib mode"
    default 0x10040
    help
        Diag buffer size in calibration mode.

config DIAG_DEVICE_USRL_SUPPORT
    bool "usb diag device support"
    default y if SOC_8910
    default n

if DIAG_DEVICE_USRL_SUPPORT
choice
    prompt "Default Userial"
    default DIAG_DEFAULT_USRL_COM1

config DIAG_DEFAULT_USRL_COM0
    bool "USRL0"

config DIAG_DEFAULT_USRL_COM1
    bool "USRL1"

config DIAG_DEFAULT_USRL_COM2
    bool "USRL2"

config DIAG_DEFAULT_USRL_COM3
    bool "USRL3"

endchoice

config DIAG_DEFAULT_USERIAL
    string
    default "DRV_NAME_USRL_COM0" if DIAG_DEFAULT_USRL_COM0
    default "DRV_NAME_USRL_COM1" if DIAG_DEFAULT_USRL_COM1
    default "DRV_NAME_USRL_COM2" if DIAG_DEFAULT_USRL_COM2
    default "DRV_NAME_USRL_COM3" if DIAG_DEFAULT_USRL_COM3
    default ""
endif

choice
    prompt "Default UART"
    default DIAG_DEFAULT_UART2 if SOC_8910

config DIAG_DEFAULT_UART1
    bool "UART1"

config DIAG_DEFAULT_UART2
    bool "UART2"

config DIAG_DEFAULT_UART3
    bool "UART3"

config DIAG_DEFAULT_UART4
    bool "UART4"

config DIAG_DEFAULT_UART5
    bool "UART5"

endchoice

config DIAG_DEFAULT_UART
    string
    default "DRV_NAME_UART1" if DIAG_DEFAULT_UART1
    default "DRV_NAME_UART2" if DIAG_DEFAULT_UART2
    default "DRV_NAME_UART3" if DIAG_DEFAULT_UART3
    default "DRV_NAME_UART4" if DIAG_DEFAULT_UART4
    default "DRV_NAME_UART5" if DIAG_DEFAULT_UART5
    default ""

config DIAG_DEFAULT_UART_BAUD
    int "Baud rate of default UART"
    default 921600 if SOC_8910
    default 921600 if SOC_6760
    default 921600 if SOC_8811

config DIAG_DEBUG_SUPPORT
    bool "Support Diag Port Debug"
    default y

endif
endmenu
```

## components/driver/Kconfig
```kconfig
# Copyright (C) 2018 RDA Technologies Limited and/or its affiliates("RDA").
# All rights reserved.
#
# This software is supplied "AS IS" without any warranties.
# RDA assumes no responsibility or liability for the use of the software,
# conveys no license or title under any patent, copyright, or mask work
# right to the product. RDA reserves the right to make changes in the
# software without notification.  RDA also make no representation or
# warranty that such application will be suitable for the specified use
# without further testing or modification.

menu "Driver configuration"

config DEBUGHOST_RX_BUF_SIZE
    hex "Debughost rx buffer size"
    default 0x200
    help
        Debughost RX buffer size.

config HOST_CMD_ENGINE_MAX_PACKET_SIZE
    hex "Host command engine packet size"
    default 0x2020
    help
        The maximum packet size of host command engine.

config UART_AUTOMODE_DEFAULT_BAUD
    int "Default baud rate of adaptive mode"
    default 115200 if SOC_8910
    default 921600 if SOC_6760
    default 115200 if SOC_8955
    default 57600 if SOC_8909
    default 115200 if SOC_8811
    help
        It is suggested to set a baud rate when UART in adaptive baud rate mode.
        UART Tx can send data througt the baud rate.


config SUPPORT_BATTERY_CHARGER
    bool "support battery charge"
    default y
    help
        enable charger.

config CAMERA_SINGLE_BUFFER
    bool "camera single buffer"
    default n
    help
        enable sinable buffer.

config WCN_WIFI_SCAN_SUPPORT
    bool "wcn wifi scan support"
    default y if SOC_8910
    default n

config USB_SUPPORT
    bool "support usb"
    default y if SOC_8910
    default n

if USB_SUPPORT
config USB_CONNECT_TIMEOUT
    int "usb connect timeout"
    default 10000
    help
        After charger on interrupt triggered, we should enable the usb controller,
        if there is not a usb host but a pure charger, we should close the controller
        to save power.
        The software judge there is a pure charger or usb host by set address command,
        if more than this <USB_CONNECT_TIMEOUT> milliseconds did not receive set address,
        the software close the usb controller.

config USB_DETECT_DEBOUNCE_TIME
    int "usb debounce time in milliseconds before eumerating"
    default 800
    help
        Debuouce a little milliseconds before start enumerating.

config USB_DEVICE_CONTROLLER_FEATURE
    hex "udc feature"
    default 0xE0
    help
        Lower 8 bits for config descriptor -> bmAttributes, higher are software defined

config USB_ETHER_HOST_MAC
    string "usb ether host mac address"
    default "\\x02\\x4b\\xb3\\xb9\\xeb\\xe5"

config USB_ETHER_DEV_MAC
    string "usb ether dev mac address"
    default "\\xfa\\x32\\x47\\x15\\xe1\\x88"

config USB_ETHER_DYNAMIC_HOST_MAC_SUPPORT
    bool "usb ether support dynamic host mac"
    default y

endif

config LCD_SUPPORT
    bool "support lcd"
    default y if SOC_8910
    default n
    help
        Whether LCD is supported.

if LCD_SUPPORT
config SUPPORT_LCD_GC9305
    bool "support GC9305 panel"
    default y
    help
        Support GC9305 LCD panel

config SUPPORT_LCD_ST7735S
    bool "support ST7735S panel"
    default y
    help
        Support ST7735S LCD panel

endif

config HEADSET_DETECT_SUPPORT
    bool "support headset detect"
    default y
    help
        enable headset detect.

if HEADSET_DETECT_SUPPORT
config HEADSET_STACK_SIZE
    int "headset thread stack size"
    default 16384
    help
        headset detect will run in separated thread. The stack size in bytes
        shall be determined by the used status.
endif

config SDMMC_SUPPORT
    bool "support SDMMC"
    default y if SOC_8910
    default n
    help
        Whether SDMMC is supported.

if SDMMC_SUPPORT
config SDMMC_CLK_FREQ_SD
    int "SDMMC clock frequency for SD"
    default 25000000
    help
        SDMMC clock frequency for SD.

config SDMMC_CLK_FREQ_SDHC
    int "SDMMC clock frequency for SDHC"
    default 50000000
    help
        SDMMC clock frequency for SDHC.
endif

endmenu
```

## components/firmwareupdate/Kconfig
```kconfig
# Copyright (C) 2018 RDA Technologies Limited and/or its affiliates("RDA").
# All rights reserved.
#
# This software is supplied "AS IS" without any warranties.
# RDA assumes no responsibility or liability for the use of the software,
# conveys no license or title under any patent, copyright, or mask work
# right to the product. RDA reserves the right to make changes in the
# software without notification.  RDA also make no representation or
# warranty that such application will be suitable for the specified use
# without further testing or modification.

menu "firmware update"

config FUPDATE_PACK_FILE_NAME
    string "update pack file name"
    default "fota.pack"
    help
        This is the file name of firmware upgrade pack file name. It is
        located under CONFIG_FS_FOTA_DATA_DIR. The configuration should
        be the same in application and bootloader.

        Don't change it unless you know what you are doing.

config FUPDATE_STAGE_FILE_NAME
    string "update stage file name"
    default "fota.stage"
    help
        This file will record firmware updata stage. It is located under
        CONFIG_FS_FOTA_DATA_DIR. The configuration should be the same in
        application and bootloader.

        Don't change it unless you know what you are doing.

config FUPDATE_TEMP_FILE_NAME
    string "update temporal file name"
    default "fota.tmp"
    help
        This is temporal file create during update in bootloader.

        Don't change it unless you know what you are doing.

config FUPDATE_SUPPORT_FLASH_PATCH
    bool "support flash differential update"
    default y
    help
        Support differential update of flash regions.

config FUPDATE_SUPPORT_FS_PATCH
    bool "support file system differential update"
    default y if SOC_8910
    default n
    help
        Support differential update of file system. Only SFFS is supported.

endmenu
```

## components/fs/Kconfig
```kconfig
# Copyright (C) 2018 RDA Technologies Limited and/or its affiliates("RDA").
# All rights reserved.
#
# This software is supplied "AS IS" without any warranties.
# RDA assumes no responsibility or liability for the use of the software,
# conveys no license or title under any patent, copyright, or mask work
# right to the product. RDA reserves the right to make changes in the
# software without notification.  RDA also make no representation or
# warranty that such application will be suitable for the specified use
# without further testing or modification.

menu "file system"

choice
    prompt "flash block device version"
    default FS_FBDEV_DEFAULT_V2
    help
        There are 2 versions of flash block device implementation. These
        2 versions are incompatible.

    config FS_FBDEV_DEFAULT_V1
        bool "version 1"

    config FS_FBDEV_DEFAULT_V2
        bool "version 2"
endchoice

config FS_FBDEV_V1_SUPPORTED
    bool "Support flash block device v1"
    default n
    help
        When enabled, flash block device v1 will be supported. Except for
        backward compatible consideration, don't enable it.

config FS_FBDEV_V2_SUPPORTED
    bool "Support flash block device v2"
    default y
    help
        When enabled, flash block device v2 will be supported.

config FS_FORMAT_FLASH_ON_MOUNT_FAIL
    bool "format at mount fail"
    default y if SOC_8955 || SOC_8909
    default n
    help
        When file system mount failed, system can't go on. When this is
        enabled, system will format the flash region, and try mount again.
        Then system can go on, but all existed data will be lost.

        Don't enable this in production.

config FS_MOUNT_SDCARD
    bool "Mount sdcard"
    default n

if FS_MOUNT_SDCARD

config FS_FORMAT_SDCARD_ON_MOUNT_FAIL
    bool "Format sdcard on mount fail"
    default y

config FS_SDCARD_MOUNT_POINT
    string "Sdcard mount point"
    default "/sdcard0"

endif

endmenu
```

## components/hal/Kconfig
```kconfig
# Copyright (C) 2018 RDA Technologies Limited and/or its affiliates("RDA").
# All rights reserved.
#
# This software is supplied "AS IS" without any warranties.
# RDA assumes no responsibility or liability for the use of the software,
# conveys no license or title under any patent, copyright, or mask work
# right to the product. RDA reserves the right to make changes in the
# software without notification.  RDA also make no representation or
# warranty that such application will be suitable for the specified use
# without further testing or modification.

menu "HAL Configurations"

config NVM_VARIANTS
    string "NVM variants"
    default ""
    help
        For each target, multiple nvm variants are supported. For each nvm
        variant, a separated pac file will be created.

        NVM variant is just a name, and the definitions are located in
        another configuration file. For 8910, each nvm variant will
        configure modem bin path and nvm prj file.

config PARTINFO_JSON_PATH
    string "partition infomation json file path"
    default ""
    help
        Partition information is stored as a json file. This json file
        will be converted into binary file, and embedded into bootloader.

        There are no default value, each target should specify the
        partition information file.

config PINMUX_JSON_PATH
    string "pinfunc defination json file path"
    default ""

config PACKAGE_FILE_JSON_PATH
    string "package raw file config path"
    default "components/nvitem/8910/default/prepack/prepack.json" if SOC_8910
    default ""

config PACKAGE_FILE_APPIMG_JSON_PATH
    string "package raw file config path for appimg example"
    default ""
    help
        default "components/nvitem/8910/default/prepack/prepack_appimg.json" if SOC_8910
        default "components/nvitem/8811/default/prepack/prepack_appimg.json" if SOC_8811

config SUPPORT_IMS_DELTA_NV
    bool "ims delta nv enable"
    default n

config PWRKEY_POWERUP
    bool "power key power up enable"
    default y

config WAKEUP_PIN_POWERUP
    bool "wakeup pin (psm_ext_int) power up enable"
    default n

config SHUTDOWN_NORMAL_POWER_OFF
    bool "shutdown normal power off"
    default n
    help
        This is a normal power off mode in pmic 2720,
        more power consupmtion than PSM mode.

config KEYPAD_CSV_PATH
    string "keypad defination csv file path"
    default "components/hal/include/8910/keypad_map_8910.csv" if SOC_8910
    default "components/hal/include/8955/keypad_map_8955.csv" if SOC_8955
    default "components/hal/include/8909/keypad_map_8909.csv" if SOC_8909

config PWRKEY_WAKEUP_PSM
    bool "power key wakeup psm"
    default n

config CHARGER_POWERUP
    bool "charger powerup the chip"
    default y

if SOC_8910
    config PMIC_INTR_GPIO
        int "GPIO for PMIC interrupt"
        default 6

    config SLEEP32K_GPIO
        int "GPIO for sleep 32K wakeup"
        default 7

    config TST_H_GROUND
        bool "tst_h to the ground"
        default n

    config CP_LTE_NBIOT_SUPPORT
        bool "CP Support Nbiot"
        default n

    config GPIO4_FORCE_PULL_UP
        bool "gpio4 (for sim detect) force pull up"
        default n

    config CAMA_POWER_ON_INIT
        bool "open CAMA power when init"
        default n

    config CAMA_CLK_FOR_AUDIO
        bool "open camera clock for audio"
        default n

    config GPIO_X_USED_FOR_VBAT_RF
        int "GPIO x is used for Vbat_RF switch"
        default 8
        help
            Then set gpio used for Vbat_RF switch.

    config GPIO_USED_FOR_VBAT_RF_SWITCH
        bool "Whether GPIO x is used for Vbat_RF switch"
        default y
        help
            Then set gpio used for Vbat_RF switch.

endif

config SYS_WDT_ENABLE
    bool "whether to enable sys_wdt"
    default y
    help
        sys_wdt is a mechanism to trigger blue screen when system is not
        responsibile. Typically, it is implemented by NMI interrupt or FIQ.

config SYS_WDT_TIMEOUT
    int "sys_wdt timeout"
    default 10000
    help
        This is sys_wdt timeout. The default strategy of watchdog feed is
        in low priority thread. So, this timeout should be relative large,
        not to hit by system busy.

config SYS_WDT_FEED_INTERVAL
    int "sys_wdt feed interval"
    default 5000
    help
        This is the interval to feed sys_wdt.

endmenu
```
